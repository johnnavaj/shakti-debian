## meta-shakti/conf/distro/debian-bullseye-ports.conf
```bitbake
# This software is a part of ISAR.

require conf/distro/debian-common.conf

BASE_DISTRO_CODENAME = "bullseye-ports"

HOST_DISTRO = "debian-${BASE_DISTRO_CODENAME}"

DISTRO_APT_SOURCES = "conf/distro/debian-${BASE_DISTRO_CODENAME}.list"
DISTRO_CONFIG_SCRIPT = "debian-configscript.sh"
DISTRO_KERNELS = "riscv64"

IMAGE_PREINSTALL += "init"

WIC_IMAGER_INSTALL += "python3-distutils"

DISTRO_BOOTSTRAP_KEYS = "https://www.ports.debian.org/archive_2019.key;sha256sum=eb2573d24ff3cbb518d8a03dbc4a7c3aef6785f2299d53cb1b2a29b7f15494b8"
HOST_DISTRO_BOOTSTRAP_KEYS = "https://www.ports.debian.org/archive_2019.key;sha256sum=eb2573d24ff3cbb518d8a03dbc4a7c3aef6785f2299d53cb1b2a29b7f15494b8"
THIRD_PARTY_APT_KEYS = "https://www.ports.debian.org/archive_2019.key;sha256sum=eb2573d24ff3cbb518d8a03dbc4a7c3aef6785f2299d53cb1b2a29b7f15494b8"
```

## meta-shakti/conf/layer.conf
```bitbake
# This software is a part of ISAR.
# Copyright (C) 2015-2017 ilbers GmbH

# We have a conf and classes directory, add to BBPATH
BBPATH .= ":${LAYERDIR}"

# We have recipes-* directories, add to BBFILES
BBFILES +=  "${LAYERDIR}/recipes-*/*/*.bb \
            ${LAYERDIR}/recipes-*/*/*.bbappend"

BBFILE_COLLECTIONS += "shakti"
BBFILE_PATTERN_shakti = "^${LAYERDIR}/"
BBFILE_PRIORITY_shakti = "20"

# This should only be incremented on significant changes that will
# cause compatibility issues with other layers
LAYERVERSION_shakti = "3"
LAYERSERIES_COMPAT_shakti = "v0.6"
LAYERDEPENDS_shakti = "core"

LAYERDIR_shakti = "${LAYERDIR}"
```
